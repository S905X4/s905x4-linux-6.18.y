## Documentation/devicetree/bindings/mmc/amlogic,meson-gx-mmc.yaml
```yaml
# SPDX-License-Identifier: (GPL-2.0-only OR BSD-2-Clause)
%YAML 1.2
---
$id: http://devicetree.org/schemas/mmc/amlogic,meson-gx-mmc.yaml#
$schema: http://devicetree.org/meta-schemas/core.yaml#

title: Amlogic SD / eMMC controller for S905/GXBB family SoCs

description:
  The MMC 5.1 compliant host controller on Amlogic provides the
  interface for SD, eMMC and SDIO devices

maintainers:
  - Neil Armstrong <neil.armstrong@linaro.org>

allOf:
  - $ref: mmc-controller.yaml#

properties:
  compatible:
    oneOf:
      - const: amlogic,meson-axg-mmc
      - items:
          - const: amlogic,meson-sc2-mmc
          - const: amlogic,meson-axg-mmc
      - items:
          - const: amlogic,meson-gx-mmc
          - const: amlogic,meson-gxbb-mmc

  reg:
    maxItems: 1

  interrupts:
    minItems: 1
    items:
      - description: mmc controller instance
      - description: card detect

  clocks:
    maxItems: 3

  clock-names:
    items:
      - const: core
      - const: clkin0
      - const: clkin1

  resets:
    maxItems: 1

  amlogic,dram-access-quirk:
    type: boolean
    description:
      set when controller's internal DMA engine cannot access the DRAM memory,
      like on the G12A dedicated SDIO controller.

  power-domains:
    maxItems: 1

  voltage-ranges:
    $ref: /schemas/types.yaml#/definitions/uint32-matrix
    description: |
      Supported card-power voltage range in millivolts for supplies that
      cannot be controlled by software. A voltage mask obtained from
      vmmc-supply takes precedence. This does not select the bus IO voltage.
    maxItems: 1
    items:
      items:
        - description: Minimum card-power voltage in millivolts.
        - description: Maximum card-power voltage in millivolts.

required:
  - compatible
  - reg
  - interrupts
  - clocks
  - clock-names
  - resets

unevaluatedProperties: false

examples:
  - |
    #include <dt-bindings/interrupt-controller/irq.h>
    #include <dt-bindings/interrupt-controller/arm-gic.h>
    mmc@70000 {
        compatible = "amlogic,meson-gx-mmc", "amlogic,meson-gxbb-mmc";
        reg = <0x70000 0x2000>;
        interrupts = <GIC_SPI 216 IRQ_TYPE_EDGE_RISING>;
        clocks = <&clk_mmc>, <&xtal>, <&clk_div>;
        clock-names = "core", "clkin0", "clkin1";
        pinctrl-0 = <&emm_pins>;
        resets = <&reset_mmc>;
    };
```

## Documentation/devicetree/bindings/phy/amlogic,g12a-usb3-pcie-phy.yaml
```yaml
# SPDX-License-Identifier: (GPL-2.0 OR BSD-2-Clause)
# Copyright 2019 BayLibre, SAS
%YAML 1.2
---
$id: http://devicetree.org/schemas/phy/amlogic,g12a-usb3-pcie-phy.yaml#
$schema: http://devicetree.org/meta-schemas/core.yaml#

title: Amlogic G12A USB3 + PCIE Combo PHY

maintainers:
  - Neil Armstrong <neil.armstrong@linaro.org>

properties:
  compatible:
    enum:
      - amlogic,g12a-usb3-pcie-phy
      - amlogic,sc2-usb3-pcie-phy

  reg:
    maxItems: 1

  clocks:
    minItems: 1
    maxItems: 2

  clock-names:
    minItems: 1
    items:
      - const: ref_clk
      - const: bgp

  resets:
    maxItems: 1

  reset-names:
    items:
      - const: phy

  "#phy-cells":
    const: 1

  phy-supply:
    description:
      Phandle to a regulator that provides power to the PHY. This
      regulator will be managed during the PHY power on/off sequence.

required:
  - compatible
  - reg
  - clocks
  - clock-names
  - resets
  - reset-names
  - "#phy-cells"

allOf:
  - if:
      properties:
        compatible:
          const: amlogic,sc2-usb3-pcie-phy
    then:
      properties:
        clocks:
          minItems: 2
        clock-names:
          minItems: 2
    else:
      properties:
        clocks:
          maxItems: 1
        clock-names:
          maxItems: 1

additionalProperties: false

examples:
  - |
    phy@46000 {
          compatible = "amlogic,g12a-usb3-pcie-phy";
          reg = <0x46000 0x2000>;
          clocks = <&ref_clk>;
          clock-names = "ref_clk";
          resets = <&phy_reset>;
          reset-names = "phy";
          #phy-cells = <1>;
    };
```

## Documentation/devicetree/bindings/pinctrl/amlogic,meson-pinctrl-sc2-periphs.yaml
```yaml
# SPDX-License-Identifier: (GPL-2.0-only OR BSD-2-Clause)
%YAML 1.2
---
$id: http://devicetree.org/schemas/pinctrl/amlogic,meson-pinctrl-sc2-periphs.yaml#
$schema: http://devicetree.org/meta-schemas/core.yaml#

title: Amlogic SC2 peripheral pin controller

maintainers:
  - Heiner Kallweit <hkallweit1@gmail.com>

description: |
  SC2 integrates direction, pull enable, pull selection and drive strength
  registers into each GPIO bank. Its pin mux register window is separate.

allOf:
  - $ref: amlogic,meson-pinctrl-common.yaml#

properties:
  compatible:
    const: amlogic,meson-sc2-periphs-pinctrl

required:
  - compatible

patternProperties:
  "^bank@[0-9a-f]+$":
    $ref: amlogic,meson-pinctrl-common.yaml#/$defs/meson-gpio
    unevaluatedProperties: false
    properties:
      reg:
        maxItems: 2
      reg-names:
        items:
          - const: mux
          - const: gpio
      gpio-line-names:
        maxItems: 87

unevaluatedProperties:
  type: object
  $ref: amlogic,meson-pinctrl-common.yaml#/$defs/meson-pins
```

## Documentation/devicetree/bindings/thermal/amlogic,thermal.yaml
```yaml
# SPDX-License-Identifier: (GPL-2.0 OR BSD-2-Clause)
%YAML 1.2
---
$id: http://devicetree.org/schemas/thermal/amlogic,thermal.yaml#
$schema: http://devicetree.org/meta-schemas/core.yaml#

title: Amlogic Thermal

maintainers:
  - Guillaume La Roque <glaroque@baylibre.com>

description: |
  Amlogic R1P1 temperature sensors use a per-sensor calibrated trim word.
  SC2 exposes this word as a second MMIO resource in the system controller,
  rather than through the AO secure syscon used on G12A and A1. The CPU and
  DDR sensors share a 500 kHz functional clock but have independent trim
  words. SC2 calibration validity is checked before the thermal zone is
  registered; no uncalibrated temperature estimate is provided.
  The SC2 driver also programs the calibrated autonomous overtemperature
  reset at a nominal 110 degrees Celsius, including on resume. This uses
  the R1P1 rising-code quantization and does not replace the thermal zone's
  lower software critical trip or CPU cooling policy.

$ref: thermal-sensor.yaml#

properties:
  compatible:
    oneOf:
      - items:
          - enum:
              - amlogic,g12a-cpu-thermal
              - amlogic,g12a-ddr-thermal
          - const: amlogic,g12a-thermal
      - const: amlogic,a1-cpu-thermal
      - enum:
          - amlogic,sc2-cpu-thermal
          - amlogic,sc2-ddr-thermal

  reg:
    minItems: 1
    maxItems: 2

  interrupts:
    maxItems: 1

  clocks:
    maxItems: 1

  power-domains:
    maxItems: 1

  amlogic,ao-secure:
    description: phandle to the ao-secure syscon
    $ref: /schemas/types.yaml#/definitions/phandle

  '#thermal-sensor-cells':
    const: 0

required:
  - compatible
  - reg
  - interrupts
  - clocks

allOf:
  - if:
      properties:
        compatible:
          contains:
            enum:
              - amlogic,sc2-cpu-thermal
              - amlogic,sc2-ddr-thermal
    then:
      properties:
        reg:
          items:
            - description: Sensor registers
            - description: Calibrated trim word in the system controller
        amlogic,ao-secure: false
    else:
      properties:
        reg:
          maxItems: 1
      required:
        - amlogic,ao-secure

unevaluatedProperties: false

examples:
  - |
    temperature-sensor@ff634800 {
        compatible = "amlogic,g12a-cpu-thermal",
                     "amlogic,g12a-thermal";
        reg = <0xff634800 0x50>;
        interrupts = <0x0 0x24 0x0>;
        clocks = <&clk 164>;
        #thermal-sensor-cells = <0>;
        amlogic,ao-secure = <&sec_AO>;
    };
...
```

## drivers/media/platform/amlogic/meson-sc2-di/Kconfig
```kconfig
# SPDX-License-Identifier: GPL-2.0-only
config VIDEO_MESON_SC2_DI
	tristate "Amlogic SC2 field-rate hardware deinterlacer"
	depends on VIDEO_DEV && ARCH_MESON
	depends on MESON_CANVAS
	select V4L2_MEM2MEM_DEV
	select VIDEOBUF2_DMA_CONTIG
	help
	  Native V4L2 M2M SC2 post-engine edge interpolation. Imports linear
	  NV12M DMABUFs and exports progressive MMAP/DMABUF surfaces at field
	  rate. This is spatial EI, not the vendor temporal MA/MC algorithm.
```

## drivers/media/platform/amlogic/meson-sc2-vdec/Kconfig
```kconfig
# SPDX-License-Identifier: GPL-2.0-only
config VIDEO_MESON_SC2_HEVC
	tristate "Amlogic SC2 stateless HEVC/AV1 decoder"
	depends on VIDEO_DEV && HAS_DMA
	depends on ARCH_MESON || COMPILE_TEST
	depends on OF && PM && MESON_SM
	select MEDIA_CONTROLLER
	select VIDEOBUF2_DMA_CONTIG
	select V4L2_MEM2MEM_DEV
	select VIDEOBUF2_V4L2
	help
	  Native V4L2 Request decoder for progressive, single-layer HEVC Main/Main10
	  and AV1 Main8 on Amlogic SC2, using one serialized hardware engine.
	  HEVC OUTPUT contains frame-based native slice controls and raw NAL
	  units without start codes. AV1 OUTPUT tile offsets address coded tile
	  bytes; sequence/frame headers are rebuilt from native AV1 controls.
	  Main8 CAPTURE is contiguous NV12. HEVC Main10 CAPTURE uses the local
	  proposed AMF0 Amlogic scatter-FBC ABI with exported vb2-owned header/body
	  storage, not an eight-bit preview. AV1 supports fixed-size <=1920x1088 streams,
	  64x64 superblocks and <=256 tiles; film grain, superresolution,
	  intrabc, frame IDs, timing models and nonidentity global motion are
	  rejected explicitly.
	  The original SC2 secure firmware must already have been preloaded.
	  Full-depth compressed scanout requires matching DRM PRIME userspace.
```

## drivers/staging/media/meson/vdec/Kconfig
```kconfig
# SPDX-License-Identifier: GPL-2.0

config VIDEO_MESON_VDEC
	tristate "Amlogic video decoder driver"
	depends on VIDEO_DEV && HAS_DMA
	depends on ARCH_MESON || COMPILE_TEST
	depends on OF && PM
	select MESON_SM if ARM64_4K_PAGES
	select MESON_SC2_DOS
	select VIDEOBUF2_DMA_CONTIG
	select VIDEOBUF2_VMALLOC
	select V4L2_MEM2MEM_DEV
	select MESON_CANVAS
	help
	Support for the video decoder found in GXBB/GXL/GXM/G12/SM1 and SC2.
	SC2 uses the original secure firmware preloaded by the platform and
	the VDEC power domain; no normal-world firmware is uploaded on SC2.
```
