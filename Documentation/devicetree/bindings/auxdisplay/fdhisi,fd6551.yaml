## Documentation/devicetree/bindings/auxdisplay/fdhisi,fd6551.yaml
```yaml
# SPDX-License-Identifier: (GPL-2.0-only OR BSD-2-Clause)
%YAML 1.2
---
$id: http://devicetree.org/schemas/auxdisplay/fdhisi,fd6551.yaml#
$schema: http://devicetree.org/meta-schemas/core.yaml#

title: FD6551 seven-segment LED display controller

maintainers:
  - hiper25 <whydonit@gmail.com>

description: |
  FD6551 drives five common-cathode grids of seven segments each with
  eight brightness settings. Its two-wire MSB-first interface uses the
  I2C write framing. The control command is at 7-bit address 0x24, and
  the five grid data commands occupy 0x33 through 0x37. All six addresses
  must be reserved for this device. An i2c-gpio bus may provide CLK and DAT.

  This binding describes four text digits and individual indicator LEDs
  on the remaining grid. Segment bits 0 through 6 correspond to the
  standard seven-segment positions A through G. The FD6551 device manual
  revision A3 (2021-08-13), section 10 describes the wire protocol.

properties:
  compatible:
    const: fdhisi,fd6551

  reg:
    const: 0x24

  fdhisi,digits:
    $ref: /schemas/types.yaml#/definitions/uint32-array
    description: Grid indices for the four text digits, from left to right.
    minItems: 4
    maxItems: 4
    uniqueItems: true
    items:
      minimum: 0
      maximum: 4

  default-brightness-level:
    description: Initial brightness, zero for off or one through eight for on.
    minimum: 0
    maximum: 8

  '#address-cells':
    const: 1

  '#size-cells':
    const: 0

  display:
    $ref: /schemas/leds/common.yaml#
    description: LED class identity of the display-wide brightness control.
    unevaluatedProperties: false

patternProperties:
  '^led@[0-9a-f]+$':
    type: object
    $ref: /schemas/leds/common.yaml#
    unevaluatedProperties: false
    description: |
      A single indicator LED. Its index is grid * 7 + segment, where grid
      is 0 through 4 and segment is 0 through 6. Indicators must not share
      any of the four text grids or duplicate another indicator index.
    properties:
      reg:
        minimum: 0
        maximum: 34
    required:
      - reg

required:
  - compatible
  - reg
  - fdhisi,digits
  - default-brightness-level
  - '#address-cells'
  - '#size-cells'
  - display

additionalProperties: false

examples:
  - |
    #include <dt-bindings/leds/common.h>
    i2c {
        #address-cells = <1>;
        #size-cells = <0>;

        display-controller@24 {
            compatible = "fdhisi,fd6551";
            reg = <0x24>;
            fdhisi,digits = <4 3 2 1>;
            default-brightness-level = <1>;
            #address-cells = <1>;
            #size-cells = <0>;

            display {
                function = "display";
            };

            led@4 {
                reg = <4>;
                function = "colon";
            };
        };
    };
```

## Documentation/devicetree/bindings/clock/amlogic,sc2-clkc.yaml
```yaml
# SPDX-License-Identifier: (GPL-2.0-only OR BSD-2-Clause)
%YAML 1.2
---
$id: http://devicetree.org/schemas/clock/amlogic,sc2-clkc.yaml#
$schema: http://devicetree.org/meta-schemas/core.yaml#

title: Amlogic SC2 clock controller

maintainers:
  - Heiner Kallweit <hkallweit1@gmail.com>

description: |
  SC2 provides peripheral clocks and PLLs through three register windows.
  CPU, DSU and protected PLL programming uses the vendor secure firmware
  clock services (SMC 0x8200009a and 0x8200009b). Clock indices are defined
  in dt-bindings/clock/amlogic,sc2-clkc.h.

  Secure clock services must implement the SC2 CPU/DSU register read and
  write ABI; registration alone does not establish firmware rate support.
  Read-only output dividers retain their firmware-programmed divisor when
  rounding rates. CPU consumers must coordinate the DSU clock and supply
  voltage before changing the CPU clock; the provider's parking notifiers
  protect clock reprogramming, not the board's DVFS policy.
  Secure PLL rate requests are limited to the documented SC2 DCO tables;
  a fixed firmware output divisor does not imply every CPU/DSU OPP can be
  generated. Consumers must reject an unachievable output rate.

properties:
  compatible:
    const: amlogic,sc2-clkc

  reg:
    items:
      - description: Peripheral clock registers
      - description: PLL registers
      - description: CPU and DSU clock registers

  reg-names:
    items:
      - const: basic
      - const: pll
      - const: cpu_clk

  clocks:
    maxItems: 1

  clock-names:
    const: xtal

  "#clock-cells":
    const: 1

required:
  - compatible
  - reg
  - reg-names
  - clocks
  - clock-names
  - "#clock-cells"

additionalProperties: false
```

## Documentation/devicetree/bindings/firmware/amlogic,meson-gxbb-sm.yaml
```yaml
# SPDX-License-Identifier: (GPL-2.0-only OR BSD-2-Clause)
%YAML 1.2
---
$id: http://devicetree.org/schemas/firmware/amlogic,meson-gxbb-sm.yaml#
$schema: http://devicetree.org/meta-schemas/core.yaml#

title: Amlogic Secure Monitor (SM)

description: |
  In the Amlogic SoCs the Secure Monitor code is used to provide access to the
  NVMEM, enable JTAG, set USB boot, etc...

  SC2 vendor firmware additionally provides video firmware-index loading and
  an explicit boot-complete notification. The notification must not be issued
  during probe: userspace validates its original local TA and firmware package
  before requesting it through the secure-monitor device's boot_complete
  attribute. It is consumed once per boot, including a nonzero secure status.

maintainers:
  - Neil Armstrong <neil.armstrong@linaro.org>

properties:
  compatible:
    oneOf:
      - const: amlogic,meson-gxbb-sm
      - items:
          - const: amlogic,meson-gx-sm
          - const: amlogic,meson-gxbb-sm
      - items:
          - const: amlogic,meson-sc2-sm
          - const: amlogic,meson-gxbb-sm

  power-controller:
    type: object
    $ref: /schemas/power/amlogic,meson-sec-pwrc.yaml#

required:
  - compatible

additionalProperties: false

examples:
  - |
    firmware {
        secure-monitor {
            compatible = "amlogic,meson-gxbb-sm";
        };
    };
```

## Documentation/devicetree/bindings/media/amlogic,meson-sc2-di.yaml
```yaml
# SPDX-License-Identifier: (GPL-2.0-only OR BSD-2-Clause)
%YAML 1.2
---
$id: http://devicetree.org/schemas/media/amlogic,meson-sc2-di.yaml#
$schema: http://devicetree.org/meta-schemas/core.yaml#

title: Amlogic SC2 hardware deinterlacer

maintainers:
  - Linux Media Mailing List <linux-media@vger.kernel.org>

description: |
  The SC2 DI post engine performs edge-interpolation deinterlacing into
  memory. It shares the VPU register aperture and power controller with
  display hardware. The VPU phandle explicitly identifies that supplier;
  there is no independently reserved overlapping MMIO range or VPU reset.
  The pre interrupt is described for hardware completeness but unused by
  the spatial EI implementation. Temporal MA/MC is not exposed.
  The canvas phandle is also an explicit supplier dependency. Driver
  removal retains both suppliers until final file and VMA release. A
  failed DMA drain quarantines ACTIVE buffers and power, blocks new
  hardware jobs device-wide, and waits for real bus idle before teardown.

properties:
  compatible:
    const: amlogic,meson-sc2-di
  amlogic,vpu:
    $ref: /schemas/types.yaml#/definitions/phandle
    description: SC2 VPU supplier providing VCBUS and PWRCTRL apertures
  amlogic,canvas:
    $ref: /schemas/types.yaml#/definitions/phandle
    description: Canvas allocator for linear NV12 surfaces
  interrupts:
    maxItems: 2
  interrupt-names:
    items:
      - const: pre
      - const: post
  clocks:
    maxItems: 4
  clock-names:
    items:
      - const: vpu
      - const: vapb
      - const: clkb
      - const: intr
  assigned-clocks:
    maxItems: 2
  assigned-clock-parents:
    maxItems: 2
  assigned-clock-rates:
    maxItems: 2
  power-domains:
    maxItems: 1

required:
  - compatible
  - amlogic,vpu
  - amlogic,canvas
  - interrupts
  - interrupt-names
  - clocks
  - clock-names
  - power-domains

additionalProperties: false
```

## Documentation/devicetree/bindings/media/amlogic,meson-sc2-hevc-decoder.yaml
```yaml
# SPDX-License-Identifier: (GPL-2.0-only OR BSD-2-Clause)
%YAML 1.2
---
$id: http://devicetree.org/schemas/media/amlogic,meson-sc2-hevc-decoder.yaml#
$schema: http://devicetree.org/meta-schemas/core.yaml#

title: Amlogic SC2 HEVC and AV1 video decoder

maintainers:
  - hiper25 <whydonit@gmail.com>

description: |
  SC2 HEVC/AV1 decoder using native stateless V4L2 Request controls and
  original SC2 secure decoder firmware. Both codecs use the same DOS
  processor, parser, MMU, reconstruction engine and mailbox; they must
  not bind independently competing drivers to this register aperture.
  The DMC aperture and bridge register are shared with other SoC clients;
  the driver modifies only the decoder-owned request/reset bits.

properties:
  compatible:
    const: amlogic,meson-sc2-hevc-decoder

  reg:
    items:
      - description: DOS decoder register aperture
      - description: DMC request and completion registers
      - description: Decoder bridge reset register

  reg-names:
    items:
      - const: dos
      - const: dmc
      - const: bridge

  interrupts:
    maxItems: 1

  clocks:
    items:
      - description: DOS bus gate
      - description: HEVC front clock
      - description: HEVC back clock

  clock-names:
    items:
      - const: dos
      - const: hevcf_mux
      - const: hevcb_mux

  power-domains:
    maxItems: 1

required:
  - compatible
  - reg
  - reg-names
  - interrupts
  - clocks
  - clock-names
  - power-domains

additionalProperties: false

examples:
  - |
    #include <dt-bindings/clock/amlogic,sc2-clkc.h>
    #include <dt-bindings/interrupt-controller/arm-gic.h>
    #include <dt-bindings/power/meson-sc2-power.h>

    video-decoder@fe320000 {
        compatible = "amlogic,meson-sc2-hevc-decoder";
        reg = <0xfe320000 0x10000>, <0xfe036000 0x100>, <0xfe002054 0x4>;
        reg-names = "dos", "dmc", "bridge";
        interrupts = <GIC_SPI 91 IRQ_TYPE_EDGE_RISING>;
        clocks = <&clkc CLKID_DOS>, <&clkc CLKID_HEVCF_MUX>,
                 <&clkc CLKID_HEVCB_MUX>;
        clock-names = "dos", "hevcf_mux", "hevcb_mux";
        power-domains = <&pwrc PWRC_SC2_DOS_HEVC_ID>;
    };
```

## Documentation/devicetree/bindings/media/amlogic,meson-sc2-vdec.yaml
```yaml
# SPDX-License-Identifier: (GPL-2.0-only OR BSD-2-Clause)
%YAML 1.2
---
$id: http://devicetree.org/schemas/media/amlogic,meson-sc2-vdec.yaml#
$schema: http://devicetree.org/meta-schemas/core.yaml#

title: Amlogic SC2 stateful VDEC1 decoder

maintainers:
  - Linux Media Mailing List <linux-media@vger.kernel.org>

description: |
  VDEC1 reconstructs H.264, MPEG-1/2 and other legacy elementary streams.
  Its mailbox and power domain are independent of HEVC, but the DOS
  aperture, DMC control and secure loader are shared. Drivers must acquire
  the common SC2 DOS lease before accessing these resources. The HEVC
  platform device retains the DOS aperture reservation. No global DOS or
  APB reset is permitted while either decoder is in use.
  SC2 feeds the VLD FIFO through its software-managed stream write pointer;
  it does not use the older GX ES parser MMIO, IRQ, clock or reset sequence.
  Factory secure firmware must have been preloaded by platform userspace.

properties:
  compatible:
    const: amlogic,meson-sc2-vdec
  reg:
    items:
      - description: Shared DOS aperture
      - description: Shared DMC request and idle acknowledgement registers
  reg-names:
    items:
      - const: dos
      - const: dmc
  interrupts:
    maxItems: 1
  interrupt-names:
    const: vdec
  clocks:
    maxItems: 2
  clock-names:
    items:
      - const: dos
      - const: vdec_1
  power-domains:
    maxItems: 1
  amlogic,canvas:
    $ref: /schemas/types.yaml#/definitions/phandle
    description: Shared canvas LUT provider

required:
  - compatible
  - reg
  - reg-names
  - interrupts
  - interrupt-names
  - clocks
  - clock-names
  - power-domains
  - amlogic,canvas

additionalProperties: false
```

## Documentation/devicetree/bindings/media/cec/amlogic,meson-gx-ao-cec.yaml
```yaml
# SPDX-License-Identifier: (GPL-2.0 OR BSD-2-Clause)
# Copyright 2019 BayLibre, SAS
%YAML 1.2
---
$id: http://devicetree.org/schemas/media/cec/amlogic,meson-gx-ao-cec.yaml#
$schema: http://devicetree.org/meta-schemas/core.yaml#

title: Amlogic Meson AO-CEC Controller

maintainers:
  - Neil Armstrong <neil.armstrong@linaro.org>

description: |
  The Amlogic Meson AO-CEC module is present is Amlogic SoCs and its purpose is
  to handle communication between HDMI connected devices over the CEC bus.

properties:
  compatible:
    enum:
      - amlogic,meson-gx-ao-cec # GXBB, GXL, GXM, G12A and SM1 AO_CEC_A module
      - amlogic,meson-g12a-ao-cec # G12A AO_CEC_B module
      - amlogic,meson-sm1-ao-cec # SM1 AO_CEC_B module
      - amlogic,meson-sc2-ao-cec # SC2 CEC_B, external clock divider

  reg:
    maxItems: 1

  clocks:
    maxItems: 1

  clock-names:
    maxItems: 1

  interrupts:
    maxItems: 1

allOf:
  - if:
      properties:
        compatible:
          const: amlogic,meson-sc2-ao-cec
    then:
      properties:
        reg:
          description: |
            CEC peripheral register window, including CEC_A at offset 0
            and CEC_B at offset 0x40. Only CEC_B is used by this binding.
        clocks:
          items:
            - description: CEC_B 32.768 kHz core clock
        clock-names:
          items:
            - const: core
  - $ref: cec-common.yaml#
  - if:
      properties:
        compatible:
          contains:
            enum:
              - amlogic,meson-gx-ao-cec

    then:
      properties:
        clocks:
          items:
            - description: AO-CEC clock

        clock-names:
          items:
            - const: core

  - if:
      properties:
        compatible:
          contains:
            enum:
              - amlogic,meson-g12a-ao-cec
              - amlogic,meson-sm1-ao-cec

    then:
      properties:
        clocks:
          items:
            - description: AO-CEC clock generator source

        clock-names:
          items:
            - const: oscin

required:
  - compatible
  - reg
  - interrupts
  - hdmi-phandle
  - clocks
  - clock-names

unevaluatedProperties: false

examples:
  - |
    cec_AO: cec@100 {
        compatible = "amlogic,meson-gx-ao-cec";
        reg = <0x00100 0x14>;
        interrupts = <199>;
        clocks = <&clkc_cec>;
        clock-names = "core";
        hdmi-phandle = <&hdmi_tx>;
    };
```
